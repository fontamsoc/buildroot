## configs/pu32_defconfig
```kconfig
BR2_pu32=y
BR2_OPTIMIZE_3=y
BR2_STATIC_LIBS=y
BR2_FORTIFY_SOURCE_NONE=y
BR2_TOOLCHAIN_EXTERNAL=y
BR2_TOOLCHAIN_EXTERNAL_PATH="/opt/pu32-toolchain/"
BR2_TOOLCHAIN_EXTERNAL_CUSTOM_PREFIX="$(ARCH)-elf"
BR2_TOOLCHAIN_EXTERNAL_HEADERS_5_13=y
BR2_TOOLCHAIN_EXTERNAL_CUSTOM_GLIBC=y
# BR2_TOOLCHAIN_EXTERNAL_HAS_SSP is not set
# BR2_TOOLCHAIN_EXTERNAL_INET_RPC is not set
BR2_TOOLCHAIN_EXTERNAL_CXX=y
BR2_TARGET_GENERIC_ISSUE=""
BR2_ROOTFS_MERGED_USR=y
BR2_TARGET_GENERIC_ROOT_PASSWD="root"
BR2_SYSTEM_BIN_SH_BASH=y
BR2_TARGET_GENERIC_GETTY_TERM="linux"
BR2_TARGET_GENERIC_GETTY_OPTIONS="-n -l /bin/-bash"
BR2_PACKAGE_BUSYBOX_SHOW_OTHERS=y
BR2_PACKAGE_FFMPEG=y
BR2_PACKAGE_FFMPEG_GPL=y
BR2_PACKAGE_FFMPEG_NONFREE=y
BR2_PACKAGE_FFMPEG_SWSCALE=y
BR2_PACKAGE_GDB=y
BR2_PACKAGE_WHETSTONE=y
BR2_PACKAGE_FBSET=y
BR2_PACKAGE_FBV=y
BR2_PACKAGE_ZLIB_NG=y
BR2_PACKAGE_DHCP=y
BR2_PACKAGE_DHCP_CLIENT=y
BR2_PACKAGE_IPROUTE2=y
BR2_PACKAGE_LRZSZ=y
BR2_PACKAGE_SOCAT=y
BR2_PACKAGE_HTOP=y
BR2_PACKAGE_NANO=y
# BR2_PACKAGE_NANO_TINY is not set
BR2_TARGET_ROOTFS_EXT2=y
BR2_TARGET_ROOTFS_EXT2_4=y
BR2_TARGET_ROOTFS_EXT2_SIZE="128M"
# BR2_TARGET_ROOTFS_TAR is not set
```

## package/pu32-binutils/Config.in
```kconfig
config BR2_PACKAGE_PU32_BINUTILS
	bool "PU32 binutils"
	depends on BR2_pu32
	select BR2_PACKAGE_EXPAT
	select BR2_PACKAGE_GMP
	select BR2_PACKAGE_MPFR
	help
	  Install binutils on the target
```

## package/pu32-gcc/Config.in
```kconfig
config BR2_PACKAGE_PU32_GCC
	bool "PU32 gcc"
	depends on BR2_pu32
	select BR2_PACKAGE_PU32_BINUTILS
	select BR2_PACKAGE_PU32_GLIBC
	help
	  Install gcc on the target
```

## package/pu32-gdbserver/Config.in
```kconfig
config BR2_PACKAGE_PU32_GDBSERVER
	bool "PU32 gdbserver"
	depends on BR2_pu32
	select BR2_PACKAGE_EXPAT
	select BR2_PACKAGE_GMP
	select BR2_PACKAGE_MPFR
	help
	  Install gdbserver on the target
```

## package/pu32-glibc/Config.in
```kconfig
config BR2_PACKAGE_PU32_GLIBC
	bool "PU32 glibc"
	depends on BR2_pu32
	select BR2_PACKAGE_PU32_LINUX_HEADERS
	help
	  Install glibc on the target
```

## package/pu32-linux-headers/Config.in
```kconfig
config BR2_PACKAGE_PU32_LINUX_HEADERS
	bool "PU32 Linux Kernel Headers"
	depends on BR2_pu32
	help
	  Install headers on the target
```
